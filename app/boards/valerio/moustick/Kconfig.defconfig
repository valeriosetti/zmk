## app/boards/valerio/moustick/Kconfig.defconfig
```kconfig
# Copyright (c) 2024 Valerio Setti
# SPDX-License-Identifier: MIT

if BOARD_MOUSTICK

if I2C_DW

config I2C_DW_CLOCK_SPEED
	default 125

endif # I2C_DW

config USB_SELF_POWERED
	default n

endif # BOARD_MOUSTICK
```

## app/boards/valerio/moustick/Kconfig.moustick
```kconfig
# Copyright (c) 2024 Valerio Setti
# SPDX-License-Identifier: MIT

config BOARD_MOUSTICK
	select SOC_RP2040
	select RP2_FLASH_W25Q080
	select ZMK_BOARD_COMPAT
	imply RETAINED_MEM
	imply RETENTION
	imply RETENTION_BOOT_MODE
```

## app/boards/valerio/moustick/board.yml
```yaml
board:
  name: moustick
  full_name: Moustick
  vendor: valerio
  socs:
  - name: rp2040
```

## app/dts/bindings/valerio,moustick-joystick.yaml
```yaml
# Copyright (c) 2024 Valerio Setti
# SPDX-License-Identifier: MIT

description: |
  Analog joystick for the Moustick board.
  Reads two ADC channels and emits REL X/Y mouse movement events.
  Deflection from center maps to cursor velocity in [-127, 127].

  Example:
    joystick: joystick {
        compatible = "valerio,moustick-joystick";
        io-channels = <&adc 0>, <&adc 1>;
        io-channel-names = "x", "y";
        deadzone = <100>;
        poll-period-ms = <15>;
    };

compatible: "valerio,moustick-joystick"

include: base.yaml

properties:
  io-channels:
    type: phandle-array
    required: true
    description: ADC channels for X and Y axes (in that order).

  io-channel-names:
    type: string-array
    required: true
    description: Must be ["x", "y"].

  deadzone:
    type: int
    default: 50
    description: |
      ADC counts around the center that report zero.
      Increase to suppress jitter at rest.

  max-speed:
    type: int
    default: 10
    description: |
      Max mouse pointer moving speed when the joystick is at full angle.

  poll-period-ms:
    type: int
    default: 10
    description: How often to sample the ADC in milliseconds.

  invert-x:
    type: boolean
    description: Invert X axis.

  invert-y:
    type: boolean
    description: Invert Y axis.
```
